## sdkconfig.defaults
```kconfig
#
# Partition Table
#
CONFIG_PARTITION_TABLE_CUSTOM=y
CONFIG_PARTITION_TABLE_CUSTOM_FILENAME="partitions.csv"
CONFIG_PARTITION_TABLE_FILENAME="partitions.csv"
CONFIG_PARTITION_TABLE_OFFSET=0x8000
CONFIG_PARTITION_TABLE_MD5=y
# end of Partition Table

#
# Memory Management
#
CONFIG_ESP_MAIN_TASK_STACK_SIZE=8192
CONFIG_ESP_SYSTEM_EVENT_TASK_STACK_SIZE=4096
CONFIG_FREERTOS_THREAD_LOCAL_STORAGE_POINTERS=3
# end of Memory Management

#
# mbedTLS
#
CONFIG_MBEDTLS_HARDWARE_AES=n
CONFIG_MBEDTLS_HARDWARE_MPI=n
CONFIG_MBEDTLS_HARDWARE_SHA=n
CONFIG_MBEDTLS_CMAC_C=y
CONFIG_MBEDTLS_SSL_PROTO_DTLS=y
CONFIG_MBEDTLS_KEY_EXCHANGE_ECJPAKE=y
# end of TLS Key Exchange Methods

CONFIG_MBEDTLS_ECJPAKE_C=y
# end of mbedTLS

#
# Zboss
#
CONFIG_ZB_ENABLED=y
CONFIG_ZB_ZCZR=y
#CONFIG_ZB_MEM_CONFIG_MED=y
# end of Zboss

#
# OTA (Over-The-Air) Updates
#
CONFIG_BOOTLOADER_APP_ROLLBACK_ENABLE=y
#CONFIG_APP_ROLLBACK_ENABLE=y
# end of OTA Updates

# Default Zigbee TX power applied at startup (in dBm). If not set, current
# value will just be printed and no change applied. Example to force 8 dBm:
# CONFIG_ZB_DEFAULT_TX_POWER=8

# end of Component config
```
